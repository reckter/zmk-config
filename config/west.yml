## config/west.yml
```yaml
manifest:
  remotes:
    - name: zmkfirmware
      url-base: https://github.com/zmkfirmware
  projects:
    - name: zmk
      remote: petejohanson
      revision: shields/kyria-rev3
      import: app/west.yml
  self:
    path: config
```
